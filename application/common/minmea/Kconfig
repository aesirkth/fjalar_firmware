## application/common/minmea/Kconfig
```kconfig
config MINMEA_LOG_LEVEL
    int "minmea log level"
    default 0 if MINMEA_LOG_LEVEL_OFF
    default 1 if MINMEA_LOG_LEVEL_ERR
    default 2 if MINMEA_LOG_LEVEL_WRN
    default 3 if MINMEA_LOG_LEVEL_INF
    default 4 if MINMEA_LOG_LEVEL_DBG
    default 2
    depends on LOG
```

## application/common/protocol/Kconfig
```kconfig
config PROTOCOL_LOG_LEVEL
    int "protocol log level"
    default 0 if PROTOCOL_LOG_LEVEL_OFF
    default 1 if PROTOCOL_LOG_LEVEL_ERR
    default 2 if PROTOCOL_LOG_LEVEL_WRN
    default 3 if PROTOCOL_LOG_LEVEL_INF
    default 4 if PROTOCOL_LOG_LEVEL_DBG
    default 2
    depends on LOG
```

## application/flight_controller/testcase.yaml
```yaml
tests:
  application_tests.runtime_test:
    platform_allow:
      - native_posix_64
    extra_args: TEST_BUILD=true
    build_only: true
```

## application/west.yml
```yaml
manifest:

  defaults:
    remote: zephyrproject

  remotes:
    - name: zephyrproject
      url-base: https://github.com/zephyrproject-rtos


  projects:
    - name: zephyr
      remote: zephyrproject
      revision: v3.6.0
      import:
        path-prefix: deps

    - name: zscilib
      remote: zephyrproject
      revision: a4bb6cfd6800e14373261904825f7f34a3a7f2e5
      path: deps/modules/lib/zscilib

  self:
    path: application
```
