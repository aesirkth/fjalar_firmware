## application/flight_controller/modules/hilsensor/Kconfig
```kconfig
config HILSENSOR
	bool "hil sensor"
	default n
	depends on DT_HAS_AESIR_HILSENSOR_ENABLED
```

## application/flight_controller/modules/hilsensor/dts/bindings/sensor/aesir,hilsensor.yaml
```yaml
description: |
  Hardware in the loop sensor

compatible: "aesir,hilsensor"

include: base.yaml
```
